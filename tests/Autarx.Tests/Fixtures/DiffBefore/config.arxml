AUTOSAR XML (schema 4-3-0)
package /Config
  module config Diag
    DiagGeneral: DiagParamA=1, DiagTesterRef=Legacy
      DiagAdvanced: DiagParamB=100
package /SwCs
  application sw component type AdaptiveApp
