AUTOSAR XML (schema 4.0)
package /Dup
  ecu instance DupEcu
