AUTOSAR XML (schema 4-3-0)
package /Vehicle/Systems
  system VehicleSystem
package /Vehicle/Ecus
  ecu instance RadarFL
    can communication connector Con_RadarFL: channel=VehicleCan
  ecu instance RadarFR
    can communication connector Con_RadarFR: channel=VehicleCan
  ecu instance Gateway
    can communication connector Con_Gateway: channel=VehicleCan
