AUTOSAR XML (schema 4-3-0)
package /Vehicle/Clusters
  can cluster VehicleCan
    can physical channel CanChannel
      frame Frame_VehicleSpeed: frame-length=64
      frame Frame_VehicleSpeedFa: frame-length=128
package /Vehicle/Signals
  i signal VehicleSpeed
  i signal BrakePressure
  i signal DiagCounter
package /Vehicle/Pdus
  pdu Pdu_VehicleSpeed
    i-signal-to-i-pdu-mappings:
      isignal to i pdu mapping VehicleSpeedMapping: i-signal=VehicleSpeed
  pdu Pdu_VehicleSpeedFa
    i-signal-to-i-pdu-mappings:
      isignal to i pdu mapping VehicleSpeedFaMapping: i-signal=VehicleSpeed
      isignal to i pdu mapping BrakePressureMapping: i-signal=BrakePressure
package /Vehicle/FrameMappings
  pdu to frame mapping Map_VehicleSpeed: frame=Frame_VehicleSpeed, i-pdu=Pdu_VehicleSpeed
  pdu to frame mapping Map_VehicleSpeedFa: frame=Frame_VehicleSpeedFa, i-pdu=Pdu_VehicleSpeedFa
package /Vehicle/Ecus
  ecu instance RadarFL
    can communication connector Con_RadarFL: channel=VehicleCan
  ecu instance Gateway
    can communication connector Con_Gateway: channel=VehicleCan
package /Config
  module config PduR
  module config Mcu
