AUTOSAR XML (schema 4-3-0)
package /Vehicle/Clusters
  can cluster PowertrainCan
package /Vehicle/Ecus
  ecu instance EngMcu
    can communication connector Conn_EngMcu: communication-cluster=PowertrainCan
