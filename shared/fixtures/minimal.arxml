AUTOSAR XML (schema 4-3-0)
package /Mcu
  module config Mcu
    McuGeneralConfiguration: McuClockSrcFailureNotification=1, McuSafetyEnable=ON
      McuModuleConfiguration: McuFrequency=80000000
package /Can
  module config Can
    CanGeneralConfiguration: CanDevErrorDetect=true, CanFilterRef=McuModuleConfiguration, CanMissingRef=McuModuleConfiguration
