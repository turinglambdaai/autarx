AUTOSAR XML (schema 4-3-0)
package /A
  ecu instance SameName
package /B
  ecu instance SameName
