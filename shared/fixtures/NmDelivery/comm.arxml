AUTOSAR XML (schema 4-3-0)
package /Cluster
  can cluster PowertrainCan
package /ECU
  ecu instance EngMcu
    can communication controller CT_EngMcu
    can communication connector Conn_EngMcu: comm-controller=CT_EngMcu
package /NM
  nm config NmConfig
    can nm cluster PT_CAN: communication-cluster=PowertrainCan
      can nm node EngMcu: controller=CT_EngMcu
