AUTOSAR XML (schema 4-3-0)
package /Config
  module config Diag
    DiagGeneral: DiagParamA=2, DiagTesterRef=RadarFL
      DiagAdvanced: DiagParamB=100
package /SwCs
  composition sw component type AdaptiveApp
