AUTOSAR XML (schema 4-3-0)
package /Vehicle/Systems
  system VehicleSystem
package /Vehicle/Clusters
  can cluster VehicleCan
package /Vehicle/Ecus
  ecu instance RadarFL
    can communication connector Con_RadarFL: channel=VehicleCan
  ecu instance Gateway
    can communication connector Con_Gateway: channel=VehicleCan
  ecu instance Display
    can communication connector Con_Display: channel=VehicleCan
